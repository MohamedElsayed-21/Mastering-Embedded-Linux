## 5-Yocto/Raspberry Pi 4 image with rpiplay, scrcpy, Nano editors and native & remote cpp  application/meta-audio-distro/conf/distro/audio.conf
```bitbake
require conf/distro/poky.conf

DISTRO="audio"
DISTRO_NAME="MOHAMED-audio"
DISTRO_VERSION="1.0"

MAINTAINER="mohamedelsayedhussein22@gmail.com"

DISTRO_FEATURES:remove = "largefile opengl ptest multiarch vulkan"
DISTRO_FEATURES:append = " userland pulseaudio alsa"
```

## 5-Yocto/Raspberry Pi 4 image with rpiplay, scrcpy, Nano editors and native & remote cpp  application/meta-info-distro/conf/distro/include/systemd.inc
```bitbake
# in the past they use this variable to make the systemd as a init manager . 
# it is exist in meta/conf/distro/include/init-manager-systemd.inc
# install systemd  as init manager 
#DISTRO_FEATURES:append=" systemd " 
# select systemd as init manager 
#VIRTUAL-RUNTIME_init_manager="systemd"
#VIRTUAL-RUNTIME_initscripts="systemd-compat-units"
# select busybox-mdev as device manager 
#VIRTUAL-RUNTIME_dev_manager="busybox-mdev"


# just use this variable . 
INIT_MANAGER = "systemd"
```

## 5-Yocto/Raspberry Pi 4 image with rpiplay, scrcpy, Nano editors and native & remote cpp  application/meta-info-distro/conf/distro/infotainment.conf
```bitbake
DISTRO="infotainment"
DISTRO_NAME="MOHAMED-infotainment"
DISTRO_VERSION="1.0"

MAINTAINER="mohamedelsayedhussein22@gmail.com"


# SDK Information.
SDK_VENDOR = "-mohamedSDK"
SDK_VERSION = "${@d.getVar('DISTRO_VERSION').replace('snapshot-${METADATA_REVISION}', 'snapshot')}"
SDK_VERSION[vardepvalue] = "${SDK_VERSION}"

SDK_NAME = "${DISTRO}-${TCLIBC}-${SDKMACHINE}-${IMAGE_BASENAME}-${TUNE_PKGARCH}-${MACHINE}"

# Installation path --> can be changed to ${HOME}-${DISTRO}-${SDK_VERSION}
SDKPATHINSTALL = "/opt/${DISTRO}/${SDK_VERSION}" 


INFOTAINMENT_DEFAULT_DISTRO_FEATURES = "largefile opengl ptest wayland multiarch vulkan x11 bluez5 qt5 "
# meta/conf/distro/include/default-distrovars.inc -->  DISTRO_FEATURES_DEFAULT ?= "acl alsa argp bluetooth debuginfod ext2 ipv4 ipv6 largefile pcmcia usbgadget usbhost wifi xattr nfs zeroconf pci 3g nfc x11 vfat seccomp"
DISTRO_FEATURES ?= "${DISTRO_FEATURES_DEFAULT} \ 
                    ${INFOTAINMENT_DEFAULT_DISTRO_FEATURES} \
                    userland  pulseaudio   "


IMAGE_INSTALL:append=" rpi-play "


# add systemd as init-process 
require conf/distro/include/systemd.inc


# prefered version for packages.
PREFERRED_VERSION_linux-yocto ?= "5.15%"
PREFERRED_VERSION_linux-yocto-rt ?= "5.15%"

# Build System configuration.
LOCALCONF_VERSION="2"

# add poky sanity bbclass
INHERIT += "poky-sanity"





   
```
